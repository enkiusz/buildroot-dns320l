## Config.in
```kconfig
source "$BR2_EXTERNAL_DLINK_DNS320L_PATH/package/dns320l-daemon/Config.in"
source "$BR2_EXTERNAL_DLINK_DNS320L_PATH/package/iniparser/Config.in"
```

## configs/dns320l_defconfig
```kconfig
BR2_arm=y
BR2_TARGET_GENERIC_GETTY_PORT="ttyS0"
BR2_SYSTEM_DHCP="eth0"
BR2_LINUX_KERNEL=y
BR2_LINUX_KERNEL_CUSTOM_VERSION=y
BR2_LINUX_KERNEL_CUSTOM_VERSION_VALUE="6.5.5"
BR2_LINUX_KERNEL_DEFCONFIG="mvebu_v5"
BR2_LINUX_KERNEL_APPENDED_UIMAGE=y
BR2_LINUX_KERNEL_UIMAGE_LOADADDR="0x8000"
BR2_LINUX_KERNEL_CUSTOM_DTS_PATH="$(BR2_EXTERNAL_DLINK_DNS320L_PATH)/board/dns320l/dts/kirkwood-dns320l.dts"
BR2_TARGET_ROOTFS_CPIO=y
BR2_TARGET_ROOTFS_CPIO_GZIP=y
BR2_TARGET_ROOTFS_CPIO_UIMAGE=y

# The package is required for proper power management
BR2_PACKAGE_DNS320L_DAEMON=y
```
